//==============================================================================
#include "Habiband_BLEAdapter.h"
#include "custom_stm.h"
//==============================================================================
static xResult HabibandBLE_RequestListener(HabibandT* device,
											HabibandBLE_RequestSelector selector,
											uint32_t args,
											uint32_t count)
{
	switch((uint8_t)selector)
	{
		case HabibandBLE_RequestWriteTemperature:
			return CustomAppWriteData(CUSTOM_STM_TEMPERATURE_VALUE, (uint8_t*)args, count) == BLE_STATUS_SUCCESS ? xResultAccept : xResultError;

		case HabibandBLE_RequestWriteAccelerometerPoints:
			return CustomAppWriteData(CUSTOM_STM_ACCELEROMETER_POINTS, (uint8_t*)args, count) == BLE_STATUS_SUCCESS ? xResultAccept : xResultError;

		case HabibandBLE_RequestWriteGyroscopePoints:
			return CustomAppWriteData(CUSTOM_STM_GYROSCOPE_POINTS, (uint8_t*)args, count) == BLE_STATUS_SUCCESS ? xResultAccept : xResultError;

		case HabibandBLE_RequestWriteECG_Points:
			return CustomAppWriteData(CUSTOM_STM_ECG_POINTS, (uint8_t*)args, count) == BLE_STATUS_SUCCESS ? xResultAccept : xResultError;

		case HabibandBLE_RequestWritePPG_Points:
			return CustomAppWriteData(CUSTOM_STM_PPG_POINTS, (uint8_t*)args, count) == BLE_STATUS_SUCCESS ? xResultAccept : xResultError;

		default: return xResultRequestIsNotFound;

	}
}
//==============================================================================
static uint32_t HabibandBLE_GetValue(HabibandT* device, HabibandBLE_ValueSelector selector)
{
	/**
	 * @brief values generated by STM32CubeMX and initialized in STM32_WPAN/App/custom_stm.c
	 */
	extern uint8_t SizeTemperature_Value;// = 4;
	extern uint8_t SizeAccelerometer_Points;// = 48;
	extern uint8_t SizeGyroscope_Points;// = 48;
	extern uint8_t SizeEcg_Points;// = 128;
	extern uint8_t SizePpg_Points;// = 64;
	extern uint8_t SizeEcg_Mode;// = 8;
	extern uint8_t SizeEkg_Cmd;// = 1;
	extern uint8_t SizeTerminalrequest;// = 40;
	extern uint8_t SizeTerminalresponse;// = 40;

	switch((uint8_t)selector)
	{
		case HabibandBLE_ValueTemperatureCharacteristicSize:
			return SizeTemperature_Value;

		case HabibandBLE_ValueAccelerometerPointsCharacteristicSize:
			return SizeAccelerometer_Points;

		case HabibandBLE_ValueGyroscopePointsCharacteristicSize:
			return SizeGyroscope_Points;

		case HabibandBLE_ValueECG_PointsCharacteristicSize:
			return SizeEcg_Points;

		case HabibandBLE_ValuePPG_PointsCharacteristicSize:
			return SizePpg_Points;
	}
	return 0;
}
//==============================================================================
HabibandBLE_InterfaceT HabibandBLE_Interface =
{
	.RequestListener = (HabibandBLE_RequestListenerT)HabibandBLE_RequestListener,
	.GetValue = (HabibandBLE_GetValueActionT)HabibandBLE_GetValue
};
//==============================================================================
/**
 * @brief adaptation of the abstract control layer for low-level functions and registers
 * @param device 
 * @return xResult 
 */
xResult Habiband_BLEAdapterInit(HabibandT* device)
{
	if (device)
	{
		device->BLE.Interface = &HabibandBLE_Interface;

		/**
		 * @brief getting points that fall on the maximum size of the characteristic
		 */
		device->BLE.ValuesInCharacteristic.Accelerometer = device->BLE.Interface->GetValue(device, HabibandBLE_ValueAccelerometerPointsCharacteristicSize);
		device->BLE.ValuesInCharacteristic.Accelerometer /= sizeof(LSM6DSOX_AccelerometerValueT);

		device->BLE.ValuesInCharacteristic.Gyroscope = device->BLE.Interface->GetValue(device, HabibandBLE_ValueGyroscopePointsCharacteristicSize);
		device->BLE.ValuesInCharacteristic.Gyroscope /= sizeof(LSM6DSOX_GyroscopeValueT);

		device->BLE.ValuesInCharacteristic.ECG = device->BLE.Interface->GetValue(device, HabibandBLE_ValueECG_PointsCharacteristicSize);
		device->BLE.ValuesInCharacteristic.ECG /= sizeof(AFE49I30_ECG_ValueT);

		device->BLE.ValuesInCharacteristic.PPG = device->BLE.Interface->GetValue(device, HabibandBLE_ValuePPG_PointsCharacteristicSize);
		device->BLE.ValuesInCharacteristic.PPG /= sizeof(AFE49I30_PPG_ValueT);

		return xResultAccept;
	}

	return xResultError;
}
//==============================================================================
